## zephyr/Kconfig
```kconfig
# tinyfota: delta firmware update for chips that cannot hold two images. These
# are the halves that live in flash.
#
# The DWM3001CDK (nRF52833, 512 KB) running ultrawidelock's lock image cannot
# do a conventional over-the-air update, and the arithmetic (measured there) is
# not close. Two full slots want 844 KB of a 512 KB part;
# an LZMA-compressed secondary still wants ~646 KB; and there is no external
# flash to stage into. What fits is a delta -- 10,906 B measured in ultrawidelock
# between two adjacent builds of its lock image.
#
# The two symbols below are deliberately separate and are never both set on one
# image. The applier goes in the BOOTLOADER, because an application cannot
# rewrite the flash it is executing from. The receiver goes in the APPLICATION,
# because the bootloader has no radio.

config TINYFOTA_APPLIER
	bool "Delta patch applier (bootloader side)"
	depends on FLASH
	help
	  Compile the detools in-place patch applier and run it from a SYS_INIT
	  at APPLICATION level, which is after the flash driver is up and before
	  MCUboot's own main().

	  Set this ONLY on the MCUboot image. On the application it would link a
	  patcher that can never safely run.

	  MEASURED in ultrawidelock at 3,176 B of bootloader flash (29,380 ->
	  32,556 B), which is why its partition map gives MCUboot 0xA000 rather
	  than the 0x8000 it needed before: 0x8000 would have left 212 B free.
	  The README's size table has the number re-measured for this module.

	  Nothing happens at boot unless a valid header is found in the
	  patch_staging partition, so the cost on a normal boot is one word read.

if TINYFOTA_APPLIER

config TINYFOTA_APPLIER_LOG
	bool "Print applier progress"
	depends on PRINTK
	help
	  Bench only. MCUboot in the sample is built with CONFIG_PRINTK=n and no
	  LOG (samples/nrf52833/sysbuild/mcuboot.conf explains what that is worth), so
	  turning this on also means turning those back on and finding the flash
	  for them.

	  Worth it exactly once: the first time a patch is applied on hardware,
	  when the difference between "declined the patch" and "applied it and
	  produced an image that fails validation" is otherwise invisible.

config TINYFOTA_APPLIER_CHUNK
	int "Patch read buffer, bytes"
	default 256
	range 64 1024
	help
	  How much of the staged patch is read from flash at a time before being
	  handed to detools. Larger is marginally faster and costs BSS. detools
	  itself is a streaming decoder and imposes no minimum.

endif # TINYFOTA_APPLIER

config TINYFOTA_RECEIVER
	bool "Delta patch receiver (application side)"
	depends on FLASH && SETTINGS
	depends on PSA_WANT_ALG_ECDSA && PSA_WANT_ECC_SECP_R1_256
	help
	  Receive a signed delta patch into the patch_staging partition and
	  reboot into the bootloader, which applies it.

	  Set this ONLY on the application image. It writes to flash and checks
	  a signature; it never patches anything, because it is executing from
	  the slot a patch rewrites.

	  Transport-independent. The Zephyr port feeds it from its own L2CAP CoC,
	  a GATT characteristic and SMP, but nothing in the receiver knows that.

	  NOTHING IS ACCEPTED until tinyfota_window_open() has been called. That
	  window is the authorization: the patch is signed and MCUboot re-checks
	  the result, so no peer can install code either way, but a closed
	  channel is what stops an unauthenticated peer in radio range from
	  burning flash cycles and forcing reboots.

if TINYFOTA_RECEIVER

config TINYFOTA_WINDOW_MS
	int "How long an update window stays open, milliseconds"
	default 300000
	range 10000 3600000
	help
	  Five minutes by default: long enough to push a patch over a connection
	  interval that the application is also using, short enough that an
	  owner who opened it and walked away is not leaving it open all day.

config TINYFOTA_CLAIM_IDLE_MS
	int "How long a stalled transfer holds the receiver, milliseconds"
	default 10000
	range 1000 300000
	help
	  The first peer to send BEGIN claims the receiver before anything is
	  authenticated. Another peer's BEGIN takes the claim over when the
	  holder has not authenticated (sent a header whose signature verifies)
	  within this long of its BEGIN, or has authenticated but sent no new
	  bytes for this long. A staged update is never taken over. Ten seconds
	  is ample for the signed preamble and for a connection-parameter update
	  mid-transfer.

config TINYFOTA_BLE_SMP
	bool "BLE transport: SMP over GATT, what the shipped clients speak"
	default y
	depends on MCUMGR && MCUMGR_TRANSPORT_BT
	depends on !TINYFOTA_TINYBLE
	select TINYFOTA_SMP_IMG
	help
	  The update path every shipped client uses: `tinyfota push`
	  (tools/tinyfota/tinyfota/smp.py), the browser page (web/index.html
	  loads fota.js on smp.js) and nRF Device Manager all speak mcumgr's
	  SMP over GATT. This serves image group 1 on it (TINYFOTA_SMP_IMG
	  below). It needs neither BT_L2CAP_DYNAMIC_CHANNEL nor BT_SMP.

	  Reserve a connection for updates: CONFIG_BT_MAX_CONN must leave a slot
	  free while the application's own peer is connected, or the board stops
	  advertising and no updater can find it. The sample enforces this at
	  build time.

	  One slot is enough when an update and the application's own BLE use
	  never overlap, for example a lock that uses BLE only to be
	  commissioned: the application advertises the SMP service while the
	  update window is open and its own link is down. With one slot no
	  second BLE peer can connect to contest the receiver's claim
	  (core/dfu_receiver.c, the CONFIG_BT_MAX_CONN note before the claim
	  check).

config TINYFOTA_BLE_GATT
	bool "BLE transport: the native GATT service (d3b5a140)"
	depends on BT_PERIPHERAL && !TINYFOTA_TINYBLE
	help
	  ports/zephyr/dfu_ble_zephyr.c: the receiver's own frames (FORMAT.md)
	  over a GATT characteristic (service d3b5a140, characteristic
	  d3b5a141), for hosts that cannot open a CoC. web/wdfu.js speaks it,
	  but no shipped page imports wdfu.js and `tinyfota push` speaks it
	  only with --native, so it is off by default.

config TINYFOTA_BLE_COC
	bool "BLE transport: the native L2CAP CoC (PSM 0x0081)"
	depends on BT_PERIPHERAL && BT_L2CAP_DYNAMIC_CHANNEL && !TINYFOTA_TINYBLE
	help
	  ports/zephyr/dfu_ble_zephyr.c: the receiver's own frames over a
	  dedicated L2CAP CoC (PSM 0x0081, 256 B SDUs). No shipped client opens
	  it, so it is off by default. The only transport here that needs
	  BT_L2CAP_DYNAMIC_CHANNEL, which in Zephyr also needs BT_SMP.

config TINYFOTA_TINYBLE
	bool "BLE transport on tinyble: SMP and the native frames, no mcumgr"
	depends on TINYBLE
	# Not select: ZCBOR is reachable from TINYFOTA_RECEIVER's own
	# dependencies (PSA_WANT_ALG_ECDSA, selected by UOSCORE, which depends
	# on ZCBOR), and a select here closes that into a Kconfig loop.
	depends on ZCBOR
	select TINYFOTA_SMP_IMG
	help
	  ports/zephyr/dfu_tinyble.c: the update channel when tinyble, not
	  Zephyr's Bluetooth host, runs the radio. tinyble's
	  CONFIG_TINYBLE_TINYFOTA adds the two GATT values and hands their
	  writes here. SMP (service 8d53dc1d), which `tinyfota push` and nRF
	  Device Manager speak, is served without mcumgr: image group 1
	  (TINYFOTA_SMP_IMG below), os echo, reset behind the same gate, and
	  mcumgr parameters. The native frames (service d3b5a140) are what
	  `tinyfota push --native` speaks. The three transports above need
	  Zephyr's host and are unavailable here.

	  Everything runs on the system work queue, tinyble's one context:
	  the flash writes and erases, and the PSA signature check.

config TINYFOTA_TINYBLE_SMP_BUF
	int "Largest SMP request reassembled on tinyble, bytes, header included"
	depends on TINYFOTA_TINYBLE
	default 384
	range 256 4096
	help
	  A request may span several GATT writes; it is collected by the length
	  in its 8-byte header, and one longer than this is refused with
	  ENOMEM. mcumgr parameters (os group command 6) report it as
	  buf_size, which nRF Device Manager sizes its uploads to. 384 is
	  CONFIG_MCUMGR_TRANSPORT_NETBUF_SIZE in the Zephyr-host door-lock
	  build. 256 holds the largest request `tinyfota push` sends at the
	  247 B ATT MTU.

config TINYFOTA_BUTTON
	bool "sw0 opens the update window"
	depends on GPIO && $(dt_alias_enabled,sw0)
	help
	  ports/zephyr/dfu_ble_zephyr.c: a press of the sw0 button opens an
	  update window, armed by tinyfota_ble_start(). Off by default because
	  sw0 belongs to the application; the sample turns it on in prj.conf.
	  An application that uses sw0 itself leaves this off and calls
	  tinyfota_window_open() from its own gesture instead.

# Not a choice: compiles ports/zephyr/dfu_ble_zephyr.c, which holds the native
# transports and the button, and declares tinyfota_ble_start().
config TINYFOTA_BLE
	bool
	default y if TINYFOTA_BLE_GATT || TINYFOTA_BLE_COC || TINYFOTA_BUTTON

config TINYFOTA_RECOVERY_GESTURE
	bool "Long sw0 hold enters MCUboot serial recovery"
	depends on TINYFOTA_BUTTON && RETENTION_BOOT_MODE
	help
	  Keep the existing short runtime press as the application DFU-window
	  gesture. Holding the same button continuously requests MCUboot through
	  the retained boot-mode byte and warm-resets into serial recovery. This
	  removes the unconditional serial-probe delay from every ordinary boot.

	  Off by default because sw0 belongs to the application; the sample
	  turns it on in prj.conf. Without it, the same retained byte can be
	  written over SMP: CONFIG_RETENTION_BOOT_MODE plus
	  CONFIG_MCUMGR_GRP_OS_RESET_BOOT_MODE let an os-group reset command
	  carry a boot_mode field (1 is the bootloader). tinyfota's reset gate
	  (reset_gate() in ports/zephyr/dfu_smp_img.c) refuses that reset
	  unless an update window is open or a patch is staged, so it needs
	  the application's own gesture first. MCUboot needs
	  CONFIG_BOOT_SERIAL_BOOT_MODE and the same retention node
	  (samples/nrf52833/sysbuild/mcuboot.overlay). `tinyfota push` does not
	  send boot_mode.

config TINYFOTA_RECOVERY_HOLD_MS
	int "MCUboot recovery hold time, milliseconds"
	depends on TINYFOTA_RECOVERY_GESTURE
	default 5000
	range 2000 15000
	help
	  The button must still be active when this delay expires. Five seconds
	  keeps an ordinary update-window press distinct from recovery.

config TINYFOTA_SMP_IMG
	bool "Serve SMP group 1, so stock mcumgr clients can push an update"
	depends on MCUMGR || TINYFOTA_TINYBLE
	help
	  Answer the mcumgr image-management group with the receiver above, so
	  that nRF Device Manager, nRF Connect for iOS or the `mcumgr` CLI can
	  upload a patch without any bespoke tooling on the other end.

	  This does NOT enable Zephyr's CONFIG_MCUMGR_GRP_IMG, which cannot be
	  built on this board at all:

	    unsatisfied dependencies: IMG_MANAGER (=n),
	                              (!MCUBOOT_BOOTLOADER_MODE_SINGLE_APP) (=n)

	  img_mgmt is gated off by single-slot mode itself, and single-slot mode
	  is what makes MCUboot fit in a 512 KB part. ports/zephyr/dfu_smp_img.c serves
	  the same group ID instead, forwarding every byte to the same checks.

	  The window gate still applies: uploads and erases are refused with
	  ACCESS_DENIED until the owner opens an update window.

	  TINYFOTA_BLE_SMP above selects this for SMP over Bluetooth; set it
	  alone for SMP over another transport (uart0 in the sample).
	  TINYFOTA_TINYBLE selects it for its own SMP server, which serves the
	  same commands (ports/zephyr/smp_group.c) without mcumgr.

	  You must also set CONFIG_MCUMGR_TRANSPORT_BT and a permission choice.
	  Note what that costs -- MCUMGR_TRANSPORT_BT_PERM_RW hands an
	  unpaired peer the SMP endpoint, and only the window gate stands in
	  front of it. The native L2CAP transport needs no such setting.

# A second definition of a Zephyr symbol, so that a single-slot build is free
# of Kconfig warnings. MCUboot's sysbuild module assigns
# CONFIG_MCUBOOT_UPDATE_FOOTER_SIZE to every application it boots
# (bootloader/mcuboot/boot/zephyr/sysbuild/CMakeLists.txt), with no opt-out
# outside the nRF54H20, but Zephyr gives the symbol a prompt only under
# MCUBOOT_IMG_MANAGER (subsys/dfu/Kconfig), which a single-slot image cannot
# build: bootutil_public.c needs a secondary slot. This prompt lets the
# assignment land instead of warning. Nothing reads the value here: its only
# user, MCUMGR_GRP_IMG_TOO_LARGE_SYSBUILD, needs MCUMGR_GRP_IMG, which
# single-slot mode refuses (TINYFOTA_SMP_IMG above).
config MCUBOOT_UPDATE_FOOTER_SIZE
	hex "Estimated update footer size, assigned by sysbuild and unused"
	depends on MCUBOOT_BOOTLOADER_MODE_SINGLE_APP
	default 0x0

module = TINYFOTA
module-str = tinyfota
source "subsys/logging/Kconfig.template.log_config"

endif # TINYFOTA_RECEIVER
```
